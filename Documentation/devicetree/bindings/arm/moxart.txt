## Documentation/devicetree/bindings/arm/moxart.txt
```
MOXA ART device tree bindings
-------------------------------------------

Boards with the MOXA ART SoC shall have the following properties:

Required root node property:

compatible = "moxa,moxart";
```

## Documentation/devicetree/bindings/arm/moxart/moxart-interrupt-controller.txt
```
* MOXA ART Interrupt Controller

MOXA ART Interrupt Controller (moxart-interrupt-controller) is used on
MOXA ART SoCs and supports 32 non-configurable number of interrupts

Main node required properties:

- compatible : should be:
	"moxa,moxart-interrupt-controller"
- interrupt-controller : Identifies the node as an interrupt controller
- #interrupt-cells : Specifies the number of cells needed to encode an
  interrupt source. The type shall be a <u32> and the value shall be 2.

  The first cell contains the interrupt number in the range [0-31].
  The second cell contains the interrupt type
- reg: physical base address and size of the intc registers map.
- interrupt-mask: Specifies if the interrupt is edge or level-triggered
  each bit represent an interrupt 0-31 where 1 signify edge

Example:

	intc: interrupt-controller@98800000 {
		compatible = "moxa,moxart-interrupt-controller";
		reg = <0x98800000 0x38>;
		interrupt-controller;
		#interrupt-cells = <1>;
		interrupt-mask = <0x00080000>;
	};
```

## Documentation/devicetree/bindings/arm/moxart/moxart-timer.txt
```
MOXA ART timer
-----------------------------------------------------
This timer is used on MOXA ART SoCs:

Required properties:
- compatible : "moxa,moxart-timer"
- reg : Register range for the timer
- interrupts : interrupt for the timer

Example:

	timer: timer@98400000 {
		compatible = "moxa,moxart-timer";
		reg = <0x98400000 0x10>;
		interrupts = <19 1>;
	};
```

## arch/arm/mach-moxart/Kconfig
```kconfig
config ARCH_MOXART
	bool "MOXA ART SoC" if (ARCH_MULTI_V4)
	select CPU_FA526
	select ARM_DMA_MEM_BUFFERABLE
	select USE_OF
	select CLKSRC_OF
	select HAVE_CLK
	select COMMON_CLK
	select GENERIC_IRQ_CHIP
	select ARCH_REQUIRE_GPIOLIB
	help
	  Say Y here if you want to run your kernel on hardware with a MOXA ART SoC.
	  This is a Faraday FA526 ARMv4 32-bit 192 MHz processor with MMU and 16KB/8KB D/I-cache (UC-7112-LX)
	  This perticular SoC is used on models UC-7101, UC-7112/UC-7110, IA240/IA241, IA3341.

if ARCH_MOXART

menu "MOXA ART SoC Implementation"

config MACH_UC7112LX
	bool "MOXA UC-7112-LX"
	depends on ARCH_MOXART
	help
	  Say Y here if you intend to run this kernel on a MOXA UC-7112-LX embedded computer.

endmenu

endif
```
